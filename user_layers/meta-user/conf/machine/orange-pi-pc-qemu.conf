## user_layers/meta-user/conf/machine/orange-pi-pc-qemu.conf
```bitbake
# This machine config makes it possible to test images using qemu. Thankfully,
# orange pi pc has board support in qemu.
# Qemu page: https://www.qemu.org/docs/master/system/arm/orangepi.html.

require conf/machine/orange-pi-pc.conf
require conf/machine/include/qemu.inc

# We need to make a separate filesystem for use with qemu but if we add it
# globally initramfs image will also get it and since we're making it from wic
# it will get a dependency on kernel and hence a dependency loop (kernel needs image
# because it builds fitimage, image needs kernel because WKS_FILE_DEPENDS contains
# kernel). So far I couldn't come with anything better than to distinguish initramfs
# images by suffix.
IMAGE_FSTYPES:append = "${@" wic.qcow2" if "${IMAGE_NAME_SUFFIX}" else ""}"

QB_USER_IMAGE_PATH ?= "${DEPLOY_DIR_IMAGE}/${IMAGE_LINK_NAME}.wic.qcow2"
QB_USER_IMAGE_SIZE ?= "2G"

# Common variables for qemuboot.bbclass.
QB_SYSTEM_NAME = "qemu-system-arm"
QB_MACHINE = "-machine orangepi-pc"
QB_CPU = "-cpu cortex-a7"
QB_SMP = "-smp 4"
QB_MEM = "-m 1024"

# Thanks to conf/machine/qemuarm-uboot.conf from meta-qemu-bsp at https://github.com/meta-erlang/meta-qemu-bsp
# for qcow2 image idea.
QB_OPT_APPEND = "-drive file=${QB_USER_IMAGE_PATH},format=qcow2,index=0,media=disk"
# The boot ROM for H3 from qemu will be used which means no executable needs to be provided explicitly.
# The rootfs is specified directly without runqemu trickery.
QB_DEFAULT_KERNEL = "none"
QB_DEFAULT_FSTYPE = "none"
QB_ROOTFS = "none"

# Assume headless distro by default. nographic must still be specified when launching runqemu
# to launch it in headless mode.
QB_GRAPHICS = ""

# Size of a qemu image must be a power of two. Qemu setup command is a good candidate for this.
# The size must be updated when necessary. qcow2 compresses sparse areas from wic image. If the
# sparse space from wic image isn't accounted for when choosing image virtual size, qemu-img will
# generate a warning saying the operation will shrink the image.
QB_SETUP_CMD = "qemu-img resize ${QB_USER_IMAGE_PATH} ${QB_USER_IMAGE_SIZE}"

# qemuboot.bbclass provides a couple of PCI devices by default. Obivously, these can't be used with SBCs.
# According to https://wp.dejvino.com/2020/07/orange-pi-zero-running-in-qemu it's possible to enable
# port forwarding using -nic user,model=allwinner-sun8i-emac,hostfwd=tcp::50022-:22.
QB_NET = "none"
QB_RNG = ""
```
